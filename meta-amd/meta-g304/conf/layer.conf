## meta-amd/meta-g304/conf/layer.conf
```bitbake
# We have a conf and classes directory, add to BBPATH
BBPATH .= ":${LAYERDIR}"

# We have recipes-* directories, add to BBFILES
BBFILES += "${LAYERDIR}/recipes-*/*/*.bb \
	${LAYERDIR}/recipes-*/*/*.bbappend"

BBFILE_COLLECTIONS += "g304-layer"
BBFILE_PATTERN_g304-layer = "^${LAYERDIR}/"
BBFILE_PRIORITY_g304-layer = "6"

LAYERSERIES_COMPAT_g304-layer = "gatesgarth hardknott"
```

## meta-amd/meta-g304/conf/machine/g304.conf
```bitbake
KMACHINE = "aspeed"
KERNEL_DEVICETREE = "${KMACHINE}-bmc-amd-g304.dtb \
                    "

UBOOT_MACHINE_g304 = "ast2600_openbmc_defconfig"
UBOOT_DEVICETREE = "ast2600-hawaii"

require conf/machine/include/ast2600.inc
require conf/machine/include/obmc-bsp-common.inc

SERIAL_CONSOLES = "115200;ttyS4"

FLASH_SIZE = "131072"

OBMC_MACHINE_FEATURES += "\
        obmc-bmc-state-mgmt \
        "

OVERRIDES .= ":amd"
```

## meta-amd/meta-lipari/conf/machine/lipari-ast2600.conf
```bitbake
KERNEL_DEVICETREE = "aspeed-ast2600-lipari.dtb"
UBOOT_MACHINE = "ast2600-lipari_spl_defconfig"
UBOOT_DEVICETREE = "ast2600-lipari"
SPL_BINARY = "spl/u-boot-spl.bin"

SOCSEC_SIGN_ENABLE = "0"

require conf/machine/include/ast2600.inc

SERIAL_CONSOLES = "115200;ttyS4"
# AST2600 EVB has 64MB SPI flash
FLASH_SIZE = "65536"

MACHINEOVERRIDES =. "lipari-ast2600:"

MACHINE_ESSENTIAL_EXTRA_RDEPENDS += "kernel-module-liparigpio"
```

## meta-amd/meta-sh5/conf/layer.conf
```bitbake
# We have a conf and classes directory, add to BBPATH
BBPATH .= ":${LAYERDIR}"

# We have recipes-* directories, add to BBFILES
BBFILES += "${LAYERDIR}/recipes-*/*/*.bb \
	${LAYERDIR}/recipes-*/*/*.bbappend"

BBFILE_COLLECTIONS += "sh5-layer"
BBFILE_PATTERN_sh5-layer = "^${LAYERDIR}/"
BBFILE_PRIORITY_sh5-layer = "6"

LAYERSERIES_COMPAT_sh5-layer = "gatesgarth hardknott"
```

## meta-amd/meta-sh5/conf/machine/sh5.conf
```bitbake
KMACHINE = "aspeed"
KERNEL_DEVICETREE = "${KMACHINE}-bmc-amd-onyx.dtb \
                     ${KMACHINE}-bmc-amd-sh5d807.dtb \
                     ${KMACHINE}-bmc-amd-parrypeak.dtb \
                    "

UBOOT_MACHINE_sh5 = "ast2600_openbmc_defconfig"
UBOOT_DEVICETREE = "ast2600-hawaii"

require conf/machine/include/ast2600.inc
require conf/machine/include/obmc-bsp-common.inc

SERIAL_CONSOLES = "115200;ttyS4"

FLASH_SIZE = "131072"

OBMC_MACHINE_FEATURES += "\
        obmc-bmc-state-mgmt \
        obmc-chassis-state-mgmt \
        obmc-host-ipmi \
        obmc-host-state-mgmt \
        obmc-phosphor-chassis-mgmt \
        obmc-phosphor-flash-mgmt \
        "

VIRTUAL-RUNTIME_obmc-host-state-manager ?= "amd-power-control"
VIRTUAL-RUNTIME_obmc-chassis-state-manager ?= "amd-power-control"

PREFERRED_PROVIDER_virtual/obmc-chassis-mgmt = "packagegroup-amd-apps"
PREFERRED_PROVIDER_virtual/obmc-host-ipmi-hw ?= "phosphor-ipmi-kcs"
PREFERRED_PROVIDER_virtual/obmc-system-mgmt = "packagegroup-amd-apps"
PREFERRED_PROVIDER_virtual/obmc-flash-mgmt = "packagegroup-amd-apps"
PREFERRED_PROVIDER_virtual/phosphor-led-manager-config-native = "sh5-led-manager-config-native"
PREFERRED_PROVIDER_virtual/phosphor-ipmi-fru-hostfw-config ?= "hostboot-inventory-config-native"

OVERRIDES .= ":amd"
```

## meta-amd/meta-sp5/conf/layer.conf
```bitbake
# We have a conf and classes directory, add to BBPATH
BBPATH .= ":${LAYERDIR}"

# We have recipes-* directories, add to BBFILES
BBFILES += "${LAYERDIR}/recipes-*/*/*.bb \
	${LAYERDIR}/recipes-*/*/*.bbappend"

BBFILE_COLLECTIONS += "sp5-layer"
BBFILE_PATTERN_sp5-layer = "^${LAYERDIR}/"
BBFILE_PRIORITY_sp5-layer = "6"

LAYERSERIES_COMPAT_sp5-layer = "gatesgarth hardknott"
```

## meta-amd/meta-sp5/conf/machine/sp5.conf
```bitbake
KMACHINE = "aspeed"
KERNEL_DEVICETREE = "${KMACHINE}-bmc-amd-onyx.dtb \
                     ${KMACHINE}-bmc-amd-onyx-i3c.dtb \
                     ${KMACHINE}-bmc-amd-quartz.dtb \
                     ${KMACHINE}-bmc-amd-quartz-i3c.dtb \
                     ${KMACHINE}-bmc-amd-ruby.dtb \
                     ${KMACHINE}-bmc-amd-ruby-i3c.dtb \
                     ${KMACHINE}-bmc-amd-titanite.dtb \
                     ${KMACHINE}-bmc-amd-titanite-i3c.dtb \
                    "

UBOOT_MACHINE_sp5 = "ast2600_openbmc_defconfig"
UBOOT_DEVICETREE = "ast2600-hawaii"

require conf/machine/include/ast2600.inc
require conf/machine/include/obmc-bsp-common.inc

SERIAL_CONSOLES = "115200;ttyS4"

FLASH_SIZE = "131072"

OBMC_MACHINE_FEATURES += "\
        obmc-bmc-state-mgmt \
        obmc-chassis-state-mgmt \
        obmc-host-ipmi \
        obmc-host-state-mgmt \
        obmc-phosphor-chassis-mgmt \
        obmc-phosphor-flash-mgmt \
        "

VIRTUAL-RUNTIME_obmc-host-state-manager ?= "amd-power-control"
VIRTUAL-RUNTIME_obmc-chassis-state-manager ?= "amd-power-control"

PREFERRED_PROVIDER_virtual/obmc-chassis-mgmt = "packagegroup-amd-apps"
PREFERRED_PROVIDER_virtual/obmc-host-ipmi-hw ?= "phosphor-ipmi-kcs"
PREFERRED_PROVIDER_virtual/obmc-system-mgmt = "packagegroup-amd-apps"
PREFERRED_PROVIDER_virtual/obmc-flash-mgmt = "packagegroup-amd-apps"
PREFERRED_PROVIDER_virtual/phosphor-led-manager-config-native = "sp5-led-manager-config-native"
PREFERRED_PROVIDER_virtual/phosphor-ipmi-fru-hostfw-config ?= "hostboot-inventory-config-native"

OVERRIDES .= ":amd"
```

## meta-amd/meta-sp6/conf/layer.conf
```bitbake
# We have a conf and classes directory, add to BBPATH
BBPATH .= ":${LAYERDIR}"

# We have recipes-* directories, add to BBFILES
BBFILES += "${LAYERDIR}/recipes-*/*/*.bb \
	${LAYERDIR}/recipes-*/*/*.bbappend"

BBFILE_COLLECTIONS += "sp6-layer"
BBFILE_PATTERN_sp6-layer = "^${LAYERDIR}/"
BBFILE_PRIORITY_sp6-layer = "6"

LAYERSERIES_COMPAT_sp6-layer = "gatesgarth hardknott"
```

## meta-amd/meta-sp6/conf/machine/sp6.conf
```bitbake
KMACHINE = "aspeed"
KERNEL_DEVICETREE = "${KMACHINE}-bmc-amd-shale64.dtb \
                     ${KMACHINE}-bmc-amd-shale96.dtb \
                     ${KMACHINE}-bmc-amd-cinnabar.dtb \
                     ${KMACHINE}-bmc-amd-sunstone.dtb \
                    "

UBOOT_MACHINE_sp6 = "ast2600_openbmc_defconfig"
UBOOT_DEVICETREE = "ast2600-hawaii"

require conf/machine/include/ast2600.inc
require conf/machine/include/obmc-bsp-common.inc

SERIAL_CONSOLES = "115200;ttyS4"

FLASH_SIZE = "131072"

OBMC_MACHINE_FEATURES += "\
        obmc-bmc-state-mgmt \
        obmc-chassis-state-mgmt \
        obmc-host-ipmi \
        obmc-host-state-mgmt \
        obmc-phosphor-chassis-mgmt \
        obmc-phosphor-flash-mgmt \
        "

VIRTUAL-RUNTIME_obmc-host-state-manager ?= "amd-power-control"
VIRTUAL-RUNTIME_obmc-chassis-state-manager ?= "amd-power-control"

PREFERRED_PROVIDER_virtual/obmc-chassis-mgmt = "packagegroup-amd-apps"
PREFERRED_PROVIDER_virtual/obmc-host-ipmi-hw ?= "phosphor-ipmi-kcs"
PREFERRED_PROVIDER_virtual/obmc-system-mgmt = "packagegroup-amd-apps"
PREFERRED_PROVIDER_virtual/obmc-flash-mgmt = "packagegroup-amd-apps"
PREFERRED_PROVIDER_virtual/phosphor-led-manager-config-native = "sp6-led-manager-config-native"
PREFERRED_PROVIDER_virtual/phosphor-ipmi-fru-hostfw-config ?= "hostboot-inventory-config-native"

OVERRIDES .= ":amd"
```

## meta-amd/meta-turin/conf/layer.conf
```bitbake
# We have a conf and classes directory, add to BBPATH
BBPATH .= ":${LAYERDIR}"

# We have recipes-* directories, add to BBFILES
BBFILES += "${LAYERDIR}/recipes-*/*/*.bb \
	${LAYERDIR}/recipes-*/*/*.bbappend"

BBFILE_COLLECTIONS += "turin-layer"
BBFILE_PATTERN_turin-layer = "^${LAYERDIR}/"
BBFILE_PRIORITY_turin-layer = "6"

LAYERSERIES_COMPAT_turin-layer = "gatesgarth hardknott"
```
